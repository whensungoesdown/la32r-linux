// SPDX-License-Identifier: GPL-2.0
/dts-v1/;
#include <dt-bindings/interrupt-controller/irq.h>

/ {
        model = "loongson,generic";
        compatible = "loongson,loongson3";
        #address-cells = <1>;
        #size-cells = <1>;

        memory {
                name = "memory";
                device_type = "memory";
                //reg = <0x2000000 0x2000000>;
                reg = <0x2000000 0x4000000>; // 64MB
                //reg = <0x2400000 0x1C00000>; // 28MB
                //reg = <0x2800000 0x1800000>; // 24MB
                //reg = <0x2a00000 0x1600000>; // 22MB
        };

//        cpuintc: interrupt-controller {
//                compatible = "loongson,cpu-interrupt-controller";
//                interrupt-controller;
//                #interrupt-cells = <1>;
//        };
//
//        timer {
//                compatible = "loongson,constant-timer";
//                interrupt-parent = <&cpuintc>;
//                interrupts = <27 IRQ_TYPE_LEVEL_HIGH>;
//                /* No MMIO reg property, as this timer is controlled via CPU CSRs */
//        };

	cpu {
		device_type = "cpu";
		compatible = "loongarch,cpu";
		/* CPU core clock frequency: 75 MHz */
		clock-frequency = <75000000>;
	};
};
